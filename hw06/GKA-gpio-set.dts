/*****
Learnig about Device Trees
Modified dereky molly's example on his site to understand it
***/

/dts-v1/;
/plugin/;

/{
       compatible = "ti,beaglebone", "ti,beaglebone-black";
       part-number = "GKA-gpio-set";
       version = "00A0";

       fragment@0 {
             target = <&am33xx_pinmux>;
            
             __overlay__ {
                  pinctrl_test: GKA_gpio_set {
			pinctrl-single,pins = <

				0x040 0x37	// P9_42 INPUT MODE7 pullup                       
                               /* OUTPUT  GPIO(mode7) 0x07 pulldown, 0x17 pullup, 0x?f no pullup/down */
			       /* INPUT   GPIO(mode7) 0x27 pulldown, 0x37 pullup, 0x?f no pullup/down */

			>;
		  };
             };
       };
};
